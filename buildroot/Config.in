## buildroot/Config.in
```kconfig
source "$BR2_EXTERNAL_OTTERCASTAUDIO_PATH/package/firmware_ap6236/Config.in"
source "$BR2_EXTERNAL_OTTERCASTAUDIO_PATH/package/firmware_ap6255/Config.in"
source "$BR2_EXTERNAL_OTTERCASTAUDIO_PATH/package/ifplugd_systemd_service/Config.in"
source "$BR2_EXTERNAL_OTTERCASTAUDIO_PATH/package/ifupdown_hotplug/Config.in"
source "$BR2_EXTERNAL_OTTERCASTAUDIO_PATH/package/ifupdown_wpasupplicant/Config.in"
source "$BR2_EXTERNAL_OTTERCASTAUDIO_PATH/package/spotifyd/Config.in"
source "$BR2_EXTERNAL_OTTERCASTAUDIO_PATH/package/ottercast_webinterface/Config.in"
source "$BR2_EXTERNAL_OTTERCASTAUDIO_PATH/package/shairport_sync_systemd_service/Config.in"
source "$BR2_EXTERNAL_OTTERCASTAUDIO_PATH/package/uhttpd_systemd_service/Config.in"
source "$BR2_EXTERNAL_OTTERCASTAUDIO_PATH/package/snapcast/Config.in"
source "$BR2_EXTERNAL_OTTERCASTAUDIO_PATH/package/shairport_sync_pulseaudio/Config.in"
source "$BR2_EXTERNAL_OTTERCASTAUDIO_PATH/package/ottercast_displayboot/Config.in"
source "$BR2_EXTERNAL_OTTERCASTAUDIO_PATH/package/ottercast_frontend/Config.in"
```

## buildroot/configs/ottercast_audio_v2_defconfig
```kconfig
BR2_arm=y
BR2_cortex_a7=y
BR2_ARM_FPU_NEON_VFPV4=y
BR2_OPTIMIZE_2=y
BR2_TOOLCHAIN_BUILDROOT_GLIBC=y
BR2_TOOLCHAIN_BUILDROOT_CXX=y
BR2_TARGET_GENERIC_HOSTNAME="ottercast-audio"
BR2_TARGET_GENERIC_ISSUE="Welcome to Buildroot for the OtterCast Audio V2!"
BR2_INIT_SYSTEMD=y
BR2_TARGET_GENERIC_GETTY_PORT="ttyS0"
BR2_TARGET_GENERIC_GETTY_BAUDRATE_115200=y
BR2_SYSTEM_DEFAULT_PATH="/bin:/sbin:/usr/bin:/usr/sbin"
BR2_ROOTFS_POST_IMAGE_SCRIPT="support/scripts/genimage.sh"
BR2_ROOTFS_POST_SCRIPT_ARGS="-c $(BR2_EXTERNAL_OTTERCASTAUDIO_PATH)/board/otter/ottercast-audio-v2/genimage.cfg"
BR2_LINUX_KERNEL=y
BR2_LINUX_KERNEL_CUSTOM_VERSION=y
BR2_LINUX_KERNEL_CUSTOM_VERSION_VALUE="5.10.15"
BR2_LINUX_KERNEL_PATCH="$(BR2_EXTERNAL_OTTERCASTAUDIO_PATH)/board/otter/ottercast-audio-v2/linux/patches"
BR2_LINUX_KERNEL_USE_CUSTOM_CONFIG=y
BR2_LINUX_KERNEL_CUSTOM_CONFIG_FILE="$(BR2_EXTERNAL_OTTERCASTAUDIO_PATH)/board/otter/ottercast-audio-v2/linux/defconfig"
BR2_LINUX_KERNEL_DTS_SUPPORT=y
BR2_LINUX_KERNEL_CUSTOM_DTS_PATH="$(BR2_EXTERNAL_OTTERCASTAUDIO_PATH)/board/otter/ottercast-audio-v2/dts/sun8i-s3-ottercast-audio-v2.dts"
BR2_PACKAGE_ALSA_UTILS=y
BR2_PACKAGE_ALSA_UTILS_AMIXER=y
BR2_PACKAGE_ALSA_UTILS_APLAY=y
BR2_PACKAGE_ALSA_UTILS_SPEAKER_TEST=y
BR2_PACKAGE_LAME=y
BR2_PACKAGE_MPG123=y
BR2_PACKAGE_PULSEAUDIO=y
BR2_PACKAGE_PULSEAUDIO_DAEMON=y
BR2_PACKAGE_SOX=y
BR2_PACKAGE_LINUX_FIRMWARE=y
BR2_PACKAGE_LINUX_FIRMWARE_RTL_87XX=y
BR2_PACKAGE_LUAJIT=y
BR2_PACKAGE_LUAJIT_COMPAT52=y
BR2_PACKAGE_CGILUA=y
BR2_PACKAGE_LUA_HTTP=y
BR2_PACKAGE_LUAJSON=y
BR2_PACKAGE_LUASOCKET=y
BR2_PACKAGE_WSAPI=y
BR2_PACKAGE_PHP=y
BR2_PACKAGE_PHP_SAPI_CGI=y
BR2_PACKAGE_PHP_SAPI_CLI=y
BR2_PACKAGE_PHP_EXT_JSON=y
BR2_PACKAGE_CA_CERTIFICATES=y
BR2_PACKAGE_LIBOPENSSL_BIN=y
BR2_PACKAGE_DTC=y
BR2_PACKAGE_DTC_PROGRAMS=y
BR2_PACKAGE_LIBCURL=y
BR2_PACKAGE_LIBCURL_CURL=y
BR2_PACKAGE_ELFUTILS=y
BR2_PACKAGE_ELFUTILS_PROGS=y
BR2_PACKAGE_HAVEGED=y
BR2_PACKAGE_DROPBEAR=y
BR2_PACKAGE_DROPBEAR_DISABLE_REVERSEDNS=y
BR2_PACKAGE_ETHTOOL=y
BR2_PACKAGE_IFUPDOWN=y
BR2_PACKAGE_IPERF3=y
BR2_PACKAGE_IPROUTE2=y
BR2_PACKAGE_IPUTILS=y
BR2_PACKAGE_IW=y
BR2_PACKAGE_SHAIRPORT_SYNC=y
BR2_PACKAGE_SHAIRPORT_SYNC_CONVOLUTION=y
BR2_PACKAGE_SHAIRPORT_SYNC_DBUS=y
BR2_PACKAGE_SHAIRPORT_SYNC_LIBSOXR=y
BR2_PACKAGE_SHAIRPORT_SYNC_MQTT=y
BR2_PACKAGE_UHTTPD=y
BR2_PACKAGE_WGET=y
BR2_PACKAGE_WPA_SUPPLICANT=y
BR2_PACKAGE_WPA_SUPPLICANT_AUTOSCAN=y
BR2_PACKAGE_BASH=y
BR2_PACKAGE_SCREEN=y
BR2_PACKAGE_TMUX=y
BR2_PACKAGE_HTOP=y
# BR2_PACKAGE_SYSTEMD_NETWORKD is not set
BR2_PACKAGE_UTIL_LINUX_RFKILL=y
BR2_PACKAGE_NANO=y
BR2_TARGET_ROOTFS_EXT2=y
BR2_TARGET_ROOTFS_EXT2_4=y
BR2_TARGET_ROOTFS_EXT2_SIZE="128M"
BR2_TARGET_UBOOT=y
BR2_TARGET_UBOOT_BUILD_SYSTEM_KCONFIG=y
BR2_TARGET_UBOOT_CUSTOM_GIT=y
BR2_TARGET_UBOOT_CUSTOM_REPO_URL="https://gitlab.denx.de/u-boot/u-boot.git"
BR2_TARGET_UBOOT_CUSTOM_REPO_VERSION="e14d5762de1db84cae6d84d59c1e40f3eb26c4c3"
BR2_TARGET_UBOOT_PATCH="$(BR2_EXTERNAL_OTTERCASTAUDIO_PATH)/board/otter/ottercast-audio-v2/u-boot/patches/"
BR2_TARGET_UBOOT_BOARD_DEFCONFIG="ottercast_audio_v2"
BR2_TARGET_UBOOT_NEEDS_DTC=y
BR2_TARGET_UBOOT_NEEDS_PYLIBFDT=y
BR2_TARGET_UBOOT_FORMAT_CUSTOM=y
BR2_TARGET_UBOOT_FORMAT_CUSTOM_NAME="u-boot-sunxi-with-spl.bin"
BR2_PACKAGE_HOST_DOSFSTOOLS=y
BR2_PACKAGE_HOST_GENIMAGE=y
BR2_PACKAGE_HOST_MTOOLS=y
BR2_PACKAGE_HOST_UBOOT_TOOLS=y
BR2_PACKAGE_HOST_UBOOT_TOOLS_BOOT_SCRIPT=y
BR2_PACKAGE_HOST_UBOOT_TOOLS_BOOT_SCRIPT_SOURCE="$(BR2_EXTERNAL_OTTERCASTAUDIO_PATH)/board/otter/ottercast-audio-v2/boot.cmd"
BR2_PACKAGE_FIRMWARE_AP6236=y
```

## buildroot/package/firmware_ap6255/Config.in
```kconfig
config BR2_PACKAGE_FIRMWARE_AP6255
	bool "Firmware for AMPAK AP6255"
	help
	  Firmware for the AP6255 (BCM4345/6 + BCM4345C0)
```

## buildroot/package/ifplugd_systemd_service/Config.in
```kconfig
config BR2_PACKAGE_IFPLUGD_SYSTEMD_SERVICE
	bool "Systemd unit file for ifplugd"
	help
	  Provides a systemd unit file for ifplugd
```

## buildroot/package/ifupdown_hotplug/Config.in
```kconfig
config BR2_PACKAGE_IFUPDOWN_HOTPLUG
	bool "hotplug support for ifupdown"
	depends on BR2_PACKAGE_IFUPDOWN
	depends on BR2_PACKAGE_HAS_UDEV
	help
	  This package adds support for device hotplugging to ifupdown
```

## buildroot/package/ifupdown_wpasupplicant/Config.in
```kconfig
config BR2_PACKAGE_IFUPDOWN_WPASUPPLICANT
	bool "Debian made WPA supplicant ifupdown glue"
	depends on BR2_PACKAGE_IFUPDOWN
	depends on BR2_PACKAGE_WPA_SUPPLICANT
	select BR2_PACKAGE_WPA_SUPPLICANT_CLI
	help
	  This package adds support for invoking wpa_supplicant from
	  ifupdown interface configs
```

## buildroot/package/ottercast_displayboot/Config.in
```kconfig
config BR2_PACKAGE_OTTERCAST_DISPLAYBOOT
       bool "OtterCast Displayboot"
       select BR2_PACKAGE_FREETYPE
       select BR2_PACKAGE_LIBPNG
       help
         Ottercast Displayboot
```

## buildroot/package/ottercast_frontend/Config.in
```kconfig
config BR2_PACKAGE_OTTERCAST_FRONTEND
		bool "OtterCast Frontend"
		select BR2_PACKAGE_DBUS
		select BR2_PACKAGE_IMAGEMAGICK
		select BR2_PACKAGE_LIBCURL
		help
			Ottercast Frontend
```

## buildroot/package/ottercast_webinterface/Config.in
```kconfig
config BR2_PACKAGE_OTTERCAST_WEBINTERFACE
       bool "OtterCast Webinterface"
       select BR2_PACKAGE_PHP
       select BR2_PACKAGE_PHP_EXT_JSON
       select BR2_PACKAGE_PHP_SAPI_CGI
       select BR2_PACKAGE_PHP_SAPI_CLI
       select BR2_PACKAGE_SYSTEMD
       select BR2_PACKAGE_UHTTPD
       help
         Ottercast Webinterface
```

## buildroot/package/shairport_sync_systemd_service/Config.in
```kconfig
config BR2_PACKAGE_SHAIRPORT_SYNC_SYSTEMD_SERVICE
	bool "Systemd unit file for shairport-sync"
	depends on BR2_PACKAGE_SHAIRPORT_SYNC_PULSEAUDIO
	depends on BR2_PACKAGE_SYSTEMD
	help
	  Provides a systemd unit file for shairport-sync
```

## buildroot/package/spotifyd/Config.in
```kconfig
config BR2_PACKAGE_SPOTIFYD
       bool "spotifyd"
       depends on BR2_PACKAGE_HOST_RUSTC_TARGET_ARCH_SUPPORTS
       select BR2_PACKAGE_HOST_RUSTC
       help
         spotifyd is an open source client for Spotify. 
         
         https://github.com/Spotifyd/spotifyd
```

## buildroot/package/uhttpd_systemd_service/Config.in
```kconfig
config BR2_PACKAGE_UHTTPD_SYSTEMD_SERVICE
	bool "Systemd unit file for uhttpd"
	help
	  Provides a systemd unit file for uhttpd
```
